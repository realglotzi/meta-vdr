## conf/layer.conf
```bitbake
# We might have a conf and classes directory, append to BBPATH
BBPATH .= ":${LAYERDIR}"

# We have a recipes directory, add to BBFILES
BBFILES += "${LAYERDIR}/recipes*/*/*.bb ${LAYERDIR}/recipes*/*/*.bbappend"

BBFILE_COLLECTIONS += "meta-vdr"
BBFILE_PATTERN_meta-vdr := "^${LAYERDIR}/"
BBFILE_PRIORITY_meta-vdr = "8"

# we want the good jpeg lib, not the ijg stuff
PREFERRED_PROVIDER_jpeg ?= "libjpeg-turbo"

# ...and the good ffmpeg...
PREFERRED_PROVIDER_ffmpeg ?= "ffmpeg"
# to get this we need to...
LICENSE_FLAGS_WHITELIST ?= "commercial"
```
